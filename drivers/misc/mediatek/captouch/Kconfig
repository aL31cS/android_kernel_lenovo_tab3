## drivers/misc/mediatek/captouch/Kconfig
```kconfig
config CUSTOM_KERNEL_CAPTOUCH
	bool "CUSTOM_KERNEL_CAPTOUCH"
	help
	  ALSPS sensor driver to detect ambient light and the object is close
	  or far awary from device. After configure this configuration,
          the specific ambient light and proximity sensor driver configuration
          should be configured as well.

source "drivers/misc/mediatek/captouch/iqs128/Kconfig"
source "drivers/misc/mediatek/captouch/iqs263/Kconfig"
```

## drivers/misc/mediatek/captouch/iqs128/Kconfig
```kconfig
config MTK_IQS128
	bool "MTK_IQS128 for MediaTek package"
	default n
	help
	It support different type sensor
	in this platform. If this option
	is set, it will support ambient
	and light sensor MTK_IQS128.
```
